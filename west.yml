## west.yml
```yaml
manifest:
  self:
    west-commands: scripts/west-commands.yml

  projects:
    - name: ros2_link6
      revision: 17e78b57f89a9277746a3286c0723890d2e20627 # jazzy 2026-10-12
      path: vendor/ros2_link6
      url: https://github.com/Kinovarobotics/ros2_link6

    - name: cartesian_controllers
      revision: f8aad77697802d9b9ca08d044b87ce58167e4bf9 # ros2 2026-10-12
      path: vendor/cartesian_controllers
      url: https://github.com/fzi-forschungszentrum-informatik/cartesian_controllers

    - name: ros2_robotiq_gripper
      revision: a74d007d8f2f06dc6a503ad21038ba869d4999a6 # main 2026-10-12
      path: vendor/ros2_robotiq_gripper
      url: https://github.com/PickNikRobotics/ros2_robotiq_gripper

    - name: picknik_controllers
      revision: 8b5f4ab308ee82198c55e1722de23ed60142a37d # main 2026-10-12
      path: vendor/picknik_controllers
      url: https://github.com/picknikrobotics/picknik_controllers

    - name: serial
      revision: d8d160678aa0b31cdf467c052b954fa287cc6cdf # ros2 2026-10-12
      path: vendor/serial
      url: https://github.com/tylerjw/serial

    - name: play_motion2
      revision: 5e41e66d7b9adf057b5a6f8bdd3a00d3918993b2 # humble-devel 2026-10-13
      path: vendor/play_motion2
      url: https://github.com/pal-robotics/play_motion2

    - name: mujoco_ros2_control
      revision: 8a083ffb1fb75e33ecd8c602d7fb06845f7cc6b8 # main 2026-10-14
      path: vendor/mujoco_ros2_control
      url: https://github.com/ros-controls/mujoco_ros2_control

    - name: better_launch
      revision: 26f5be8bea20a6371138314cae47b0877933d0f5 # 2026-10-12
      path: vendor/better_launch
      url: https://github.com/dfki-ric/better_launch
```
